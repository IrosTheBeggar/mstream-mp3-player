// SPDX-License-Identifier: GPL-3.0-or-later
// Copyright (C) 2026 IrosTheBeggar

// Host tests for DanceBudget (B.6's per-move budget, the dirty rule of B.5
// in DanceStage.h, D.2's start-spot hook, the verdict and the one-move-a-
// frame pass): docs/DANCE-SPRITES.md, Appendix E.4's test_dance_budget list,
// item by item. Written from the doc alone, without reading the
// implementation.
//
// - BudgetVectors.h (generated by dancepack.py) pins every case, every
//   move's verdict and one frame trace per move of the fixture; the C++
//   must agree bit for bit.
// - The worked examples are A.17's dot, B.4's move (built here with
//   beatscript::miniPack) and B.5's rects.
// - Packs are exact-size heap copies and the median's scratch an exact-size
//   heap block of kBudgetMaxFrames values, so ASan reports an overrun.
//
// Run: pio test -e native -f test_dance_budget (and native_asan, E.4).
#if defined(DANCE_ASAN) && !defined(__SANITIZE_ADDRESS__)
#error "native_asan: -fsanitize=address didn't reach the compiler (docs/DANCE-SPRITES.md, Appendix D.5)"
#endif

#include <unity.h>

#include <algorithm>
#include <cstdarg>
#include <cstdio>
#include <cstring>
#include <memory>
#include <string>
#include <vector>

#include "../support/dance/BeatScript.h"
#include "../support/dance/BudgetVectors.h"
#include "DanceBudget.h"
#include "DancePack.h"
#include "DanceStage.h"
#include "DrawnCharacter.h"

using beatscript::CardDancer;
using beatscript::OpenPack;
using packedit::Bytes;

namespace {

char g_ctx[256] = "";
void ctx(const char* fmt, ...) {
  va_list ap;
  va_start(ap, fmt);
  std::vsnprintf(g_ctx, sizeof g_ctx, fmt, ap);
  va_end(ap);
}

dance::StageRect rect(int x0, int y0, int x1, int y1) {
  dance::StageRect r;
  r.x0 = static_cast<int16_t>(x0);
  r.y0 = static_cast<int16_t>(y0);
  r.x1 = static_cast<int16_t>(x1);
  r.y1 = static_cast<int16_t>(y1);
  return r;
}
bool sameRect(const dance::StageRect& a, const dance::StageRect& b) {
  return a.x0 == b.x0 && a.y0 == b.y0 && a.x1 == b.x1 && a.y1 == b.y1;
}

// The median's scratch: exactly kBudgetMaxFrames values on the heap.
struct Scratch {
  std::unique_ptr<uint32_t[]> v{new uint32_t[dance::kBudgetMaxFrames]};
  uint32_t* get() { return v.get(); }
};

std::string reasonText(const dance::Reason& r) {
  char buf[dance::kReasonChars];
  dance::formatReason(r, buf, sizeof buf);
  return buf;
}

dance::BudgetCaseSpec spec(int fps, int pace, bool mirrored, int spot) {
  dance::BudgetCaseSpec s;
  s.fps = static_cast<uint8_t>(fps);
  s.pace = static_cast<uint8_t>(pace);
  s.mirrored = mirrored;
  s.spot = static_cast<int8_t>(spot);
  return s;
}

// The fixture with a patch applied to a copy (the CRC recomputed).
Bytes patchedFixture(void (*edit)(Bytes&)) {
  Bytes t = packedit::testPack();
  edit(t);
  packedit::fixCrc(t);
  return t;
}
uint32_t recordAt(const Bytes& t, int move) { return packedit::entry(t, "MOVS").off + 4 + 32 * move; }
uint32_t stepAt(const Bytes& t, int move, int k) {
  return packedit::entry(t, "STEP").off + 8 * (packedit::get16(t, recordAt(t, move) + 24) + k);
}

void clearHeavy(Bytes& t) { t[recordAt(t, beatscript::kHeavy) + 8] &= static_cast<uint8_t>(~dance::kHeavy); }
// big keyed -12,0 and 12,0, as heavy is.
void bigLikeHeavy(Bytes& t) {
  t[stepAt(t, beatscript::kBig, 0) + 4] = static_cast<uint8_t>(-12);
  t[stepAt(t, beatscript::kBig, 1) + 4] = 12;
}
void twoRed(Bytes& t) {
  clearHeavy(t);
  bigLikeHeavy(t);
}
// test_dancepack.py's case: walk without its mirror flag, start_at centre,
// every step's dx 10 (extents (-24, 68) and (-64, 28): no start spot
// unmirrored, spot 0 mirrored only).
void walkFromNoSpot(Bytes& t) {
  const uint32_t rec = recordAt(t, beatscript::kWalk);
  t[rec + 8] &= static_cast<uint8_t>(~dance::kMirror);
  t[rec + 12] = 1;
  for (int k = 0; k < t[rec + 23]; ++k) t[stepAt(t, beatscript::kWalk, k) + 4] = 10;
}

}  // namespace

void setUp() {}
void tearDown() {}

// ===========================================================================
// 1. B.5: dirtyPx, rects and the 1.3 rule.

void test_dirty_rule() {
  // B.5's example on B.4's move, unmirrored: ticks 6 and 15 (96 px each, a
  // union of 351 px > 1.3 x 192: two rects); ticks 0 and 24 (140 px each, a
  // union of 1,484).
  const dance::StageRect t6 = rect(65, 134, 73, 146), t15 = rect(84, 135, 92, 147);
  TEST_ASSERT_EQUAL_INT32(96, dance::rectArea(t6));
  TEST_ASSERT_EQUAL_INT32(96, dance::rectArea(t15));
  TEST_ASSERT_EQUAL_INT32(351, dance::rectArea(dance::rectUnion(t6, t15)));
  TEST_ASSERT_EQUAL_UINT32(192, dance::dirtyPx(&t6, t15));
  const dance::StageRect t0 = rect(57, 141, 67, 155), t24 = rect(153, 141, 163, 155);
  TEST_ASSERT_EQUAL_INT32(140, dance::rectArea(t0));
  TEST_ASSERT_EQUAL_INT32(1484, dance::rectArea(dance::rectUnion(t0, t24)));
  TEST_ASSERT_EQUAL_UINT32(280, dance::dirtyPx(&t0, t24));
  // No last frame: area(now).
  TEST_ASSERT_EQUAL_UINT32(140, dance::dirtyPx(nullptr, t0));
  // Overlapping rects: one union.
  const dance::StageRect a = rect(10, 10, 30, 30), b = rect(12, 11, 32, 31);
  TEST_ASSERT_EQUAL_UINT32(22 * 21, dance::dirtyPx(&a, b));
  // Empty rects: area 0, union adds nothing, two empty ones give {0,0,0,0}.
  const dance::StageRect none = rect(0, 0, 0, 0), flat = rect(5, 5, 9, 5), inverted = rect(9, 9, 5, 12);
  TEST_ASSERT_TRUE(dance::rectEmpty(none));
  TEST_ASSERT_TRUE(dance::rectEmpty(flat));
  TEST_ASSERT_TRUE(dance::rectEmpty(inverted));
  TEST_ASSERT_FALSE(dance::rectEmpty(a));
  TEST_ASSERT_EQUAL_INT32(0, dance::rectArea(none));
  TEST_ASSERT_EQUAL_INT32(0, dance::rectArea(flat));
  TEST_ASSERT_EQUAL_INT32(0, dance::rectArea(inverted));
  TEST_ASSERT_TRUE(sameRect(a, dance::rectUnion(a, flat)));
  TEST_ASSERT_TRUE(sameRect(a, dance::rectUnion(inverted, a)));
  TEST_ASSERT_TRUE(sameRect(none, dance::rectUnion(flat, inverted)));
  TEST_ASSERT_EQUAL_UINT32(400, dance::dirtyPx(&none, a));
  TEST_ASSERT_EQUAL_UINT32(400, dance::dirtyPx(&a, none));
  TEST_ASSERT_EQUAL_UINT32(0, dance::dirtyPx(&none, none));
  TEST_ASSERT_EQUAL_UINT32(0, dance::dirtyPx(nullptr, inverted));
  // The 1.3 boundary: two 10x10 rects 16 px apart give a union of 260 px,
  // and 10 x 260 = 13 x 200 is not more: the union. 17 apart: two rects.
  const dance::StageRect p = rect(0, 0, 10, 10), q16 = rect(16, 0, 26, 10), q17 = rect(17, 0, 27, 10);
  TEST_ASSERT_EQUAL_UINT32(260, dance::dirtyPx(&p, q16));
  TEST_ASSERT_EQUAL_UINT32(200, dance::dirtyPx(&p, q17));
  // Large rects: the products are taken in 64 bits.
  const dance::StageRect s0 = rect(0, 0, 320, 164), s1 = rect(0, 0, 320, 164);
  TEST_ASSERT_EQUAL_UINT32(52480, dance::dirtyPx(&s0, s1));
  // The stage's geometry (6.1).
  TEST_ASSERT_EQUAL_INT(64, dance::spotX(-1));
  TEST_ASSERT_EQUAL_INT(160, dance::spotX(0));
  TEST_ASSERT_EQUAL_INT(256, dance::spotX(1));
  TEST_ASSERT_EQUAL_INT(64, dance::spotX(-7));
  TEST_ASSERT_EQUAL_INT(256, dance::spotX(5));
  TEST_ASSERT_EQUAL_INT(320, dance::kStage.w);
  TEST_ASSERT_EQUAL_INT(164, dance::kStage.h);
  TEST_ASSERT_EQUAL_INT(153, dance::kStage.groundY);
  TEST_ASSERT_EQUAL_INT(36, dance::kStage.y);
  TEST_ASSERT_EQUAL_INT(100, dance::kLegacyStage.x);
  TEST_ASSERT_EQUAL_INT(145, dance::kLegacyStage.groundY);
}

// ===========================================================================
// 2. kBudgetCases: the specs and each case's N, median and peak.

void test_budget_cases() {
  OpenPack op;
  TEST_ASSERT_TRUE(op.open(packedit::testPack()));
  const dance::Pack& p = op.pack;
  using namespace dancevec;
  Scratch scratch;
  int row = 0;
  for (int m = 0; m < p.moveCount(); ++m) {
    dance::BudgetCaseSpec specs[dance::kBudgetMaxCases];
    const int n = dance::budgetCaseSpecs(p, m, specs);
    int want = 0;
    for (int i = 0; i < kBudgetCasesCount; ++i)
      if (kBudgetCases[i].move == m) ++want;
    ctx("move %d (%s): %d cases", m, p.moveName(m), want);
    TEST_ASSERT_EQUAL_INT_MESSAGE(want, n, g_ctx);
    for (int i = 0; i < n; ++i, ++row) {
      const BudgetCase& c = kBudgetCases[row];
      ctx("move %d case %d: %u fps, pace %u, %s, spot %d", m, i, c.fps, c.pace, c.mirrored ? "mirrored" : "unmirrored",
          c.spot);
      TEST_ASSERT_EQUAL_INT_MESSAGE(m, c.move, g_ctx);
      TEST_ASSERT_EQUAL_INT_MESSAGE(c.fps, specs[i].fps, g_ctx);
      TEST_ASSERT_EQUAL_INT_MESSAGE(c.pace, specs[i].pace, g_ctx);
      TEST_ASSERT_EQUAL_MESSAGE(c.mirrored != 0, specs[i].mirrored, g_ctx);
      TEST_ASSERT_EQUAL_INT_MESSAGE(c.spot, specs[i].spot, g_ctx);
      const dance::BudgetCaseResult r = dance::budgetCase(p, m, specs[i], scratch.get());
      TEST_ASSERT_EQUAL_INT_MESSAGE(c.frames, r.frames, g_ctx);
      TEST_ASSERT_EQUAL_UINT32_MESSAGE(c.median, r.median, g_ctx);
      TEST_ASSERT_EQUAL_UINT32_MESSAGE(c.peak, r.peak, g_ctx);
      // Without a scratch: the same N and peak, median 0.
      const dance::BudgetCaseResult z = dance::budgetCase(p, m, specs[i], nullptr);
      TEST_ASSERT_EQUAL_INT_MESSAGE(c.frames, z.frames, g_ctx);
      TEST_ASSERT_EQUAL_UINT32_MESSAGE(0, z.median, g_ctx);
      TEST_ASSERT_EQUAL_UINT32_MESSAGE(c.peak, z.peak, g_ctx);
    }
  }
  TEST_ASSERT_EQUAL_INT(kBudgetCasesCount, row);
  // A beat move at pace 0, or a record that doesn't read, has no frames.
  const dance::BudgetCaseResult none = dance::budgetCase(p, beatscript::kBounce, spec(30, 0, false, 0), scratch.get());
  TEST_ASSERT_EQUAL_INT(0, none.frames);
  TEST_ASSERT_EQUAL_UINT32(0, none.peak);
  dance::BudgetCaseSpec specs[dance::kBudgetMaxCases];
  TEST_ASSERT_EQUAL_INT(0, dance::budgetCaseSpecs(p, 14, specs));
  TEST_ASSERT_EQUAL_INT(0, dance::budgetCaseSpecs(p, -1, specs));
  TEST_ASSERT_EQUAL_INT(0, dance::budgetCase(p, 99, spec(30, 120, false, 0), scratch.get()).frames);
}

// ===========================================================================
// 3. kMoveBudgets: each move's median, peak and light.

void test_move_budgets() {
  OpenPack op;
  TEST_ASSERT_TRUE(op.open(packedit::testPack()));
  const dance::Pack& p = op.pack;
  using namespace dancevec;
  TEST_ASSERT_EQUAL_INT(14, kMoveBudgetsCount);
  Scratch scratch;
  for (int i = 0; i < kMoveBudgetsCount; ++i) {
    const MoveBudget& mb = kMoveBudgets[i];
    int cases = 0;
    for (int k = 0; k < kBudgetCasesCount; ++k)
      if (kBudgetCases[k].move == mb.move) ++cases;
    ctx("move %u (%s)", mb.move, p.moveName(mb.move));
    const dance::BudgetResult r = dance::budget(p, mb.move, scratch.get());
    TEST_ASSERT_EQUAL_UINT32_MESSAGE(mb.median, r.median, g_ctx);
    TEST_ASSERT_EQUAL_UINT32_MESSAGE(mb.peak, r.peak, g_ctx);
    TEST_ASSERT_EQUAL_INT_MESSAGE(mb.light, static_cast<int>(r.light), g_ctx);
    TEST_ASSERT_EQUAL_INT_MESSAGE(cases, r.cases, g_ctx);
    const dance::BudgetResult z = dance::budget(p, mb.move, nullptr);
    TEST_ASSERT_EQUAL_UINT32_MESSAGE(0, z.median, g_ctx);
    TEST_ASSERT_EQUAL_UINT32_MESSAGE(mb.peak, z.peak, g_ctx);
    TEST_ASSERT_TRUE_MESSAGE(z.light == r.light, g_ctx);
  }
  // big amber, heavy red, the rest green (C.10).
  TEST_ASSERT_TRUE(dance::budget(p, beatscript::kBig, scratch.get()).light == dance::BudgetLight::Amber);
  TEST_ASSERT_TRUE(dance::budget(p, beatscript::kHeavy, scratch.get()).light == dance::BudgetLight::Red);
  // The lights' bounds.
  TEST_ASSERT_TRUE(dance::budgetLight(0) == dance::BudgetLight::Green);
  TEST_ASSERT_TRUE(dance::budgetLight(16000) == dance::BudgetLight::Green);
  TEST_ASSERT_TRUE(dance::budgetLight(16001) == dance::BudgetLight::Amber);
  TEST_ASSERT_TRUE(dance::budgetLight(20000) == dance::BudgetLight::Amber);
  TEST_ASSERT_TRUE(dance::budgetLight(20001) == dance::BudgetLight::Red);
  TEST_ASSERT_TRUE(dance::budgetLight(0xFFFFFFFFu) == dance::BudgetLight::Red);
  TEST_ASSERT_EQUAL_INT(0, static_cast<int>(dance::BudgetLight::Green));
  TEST_ASSERT_EQUAL_INT(1, static_cast<int>(dance::BudgetLight::Amber));
  TEST_ASSERT_EQUAL_INT(2, static_cast<int>(dance::BudgetLight::Red));
  TEST_ASSERT_EQUAL_UINT32(16000, dance::kGreenPx);
  TEST_ASSERT_EQUAL_UINT32(20000, dance::kAmberPx);
  TEST_ASSERT_EQUAL_INT(24, dance::kBudgetMaxCases);  // 2 fps x 3 paces x 2 orientations x 2 start spots
  TEST_ASSERT_EQUAL_INT(364, dance::kBudgetMaxFrames);
}

// ===========================================================================
// 4. kTrace through BudgetRun, frame for frame.

void test_traces() {
  OpenPack op;
  TEST_ASSERT_TRUE(op.open(packedit::testPack()));
  const dance::Pack& p = op.pack;
  using namespace dancevec;
  int total = 0;
  for (int t = 0; t < kTraceCasesCount; ++t) {
    const TraceCase& tc = kTraceCases[t];
    dance::BudgetRun run(p, tc.move, spec(tc.fps, tc.pace, tc.mirrored != 0, tc.spot));
    dance::BudgetFrame f;
    int n = 0;
    while (run.next(&f)) {
      ctx("trace of move %u, frame %d", tc.move, n);
      TEST_ASSERT_TRUE_MESSAGE(n < tc.count, g_ctx);
      const TraceFrame& w = kTrace[tc.first + n];
      TEST_ASSERT_EQUAL_INT_MESSAGE(w.n, f.n, g_ctx);
      TEST_ASSERT_EQUAL_UINT32_MESSAGE(w.pos16, f.pos16, g_ctx);
      TEST_ASSERT_EQUAL_HEX16_MESSAGE(w.frame, f.place.frame | (f.place.mirrored ? 0x8000 : 0), g_ctx);
      TEST_ASSERT_EQUAL_INT_MESSAGE(w.rootX, f.place.rootX, g_ctx);
      TEST_ASSERT_EQUAL_INT_MESSAGE(w.rootY, f.place.rootY, g_ctx);
      TEST_ASSERT_TRUE_MESSAGE(sameRect(rect(w.x0, w.y0, w.x1, w.y1), f.place.rect), g_ctx);
      TEST_ASSERT_EQUAL_UINT32_MESSAGE(w.dirty, f.dirty, g_ctx);
      ++n;
      ++total;
    }
    ctx("trace of move %u: %d frames", tc.move, n);
    TEST_ASSERT_EQUAL_INT_MESSAGE(tc.count, n, g_ctx);
    TEST_ASSERT_FALSE_MESSAGE(run.next(&f), g_ctx);  // stays done
  }
  TEST_ASSERT_EQUAL_INT(kTraceCount, total);
  // A beat move at pace 0: no frames.
  dance::BudgetRun none(p, beatscript::kBounce, spec(30, 0, false, 0));
  dance::BudgetFrame f;
  TEST_ASSERT_FALSE(none.next(&f));
}

// ===========================================================================
// 5. The worked examples: A.17's dot and B.6's (B.4's move).

void test_worked_examples() {
  Scratch scratch;
  {
    OpenPack op;
    TEST_ASSERT_TRUE(op.open(packedit::dotPack()));
    dance::BudgetCaseSpec specs[dance::kBudgetMaxCases];
    const int n = dance::budgetCaseSpecs(op.pack, 0, specs);
    TEST_ASSERT_EQUAL_INT(6, n);
    const int paces[3] = {72, 124, 176};
    for (int i = 0; i < n; ++i) {
      ctx("the dot's case %d", i);
      TEST_ASSERT_EQUAL_INT_MESSAGE(i < 3 ? 24 : 30, specs[i].fps, g_ctx);
      TEST_ASSERT_EQUAL_INT_MESSAGE(paces[i % 3], specs[i].pace, g_ctx);
      TEST_ASSERT_FALSE_MESSAGE(specs[i].mirrored, g_ctx);
      TEST_ASSERT_EQUAL_INT_MESSAGE(0, specs[i].spot, g_ctx);
      const dance::BudgetCaseResult r = dance::budgetCase(op.pack, 0, specs[i], scratch.get());
      TEST_ASSERT_EQUAL_UINT32_MESSAGE(4, r.median, g_ctx);
      TEST_ASSERT_EQUAL_UINT32_MESSAGE(6, r.peak, g_ctx);
    }
    const dance::BudgetResult b = dance::budget(op.pack, 0, scratch.get());
    TEST_ASSERT_EQUAL_UINT32(4, b.median);
    TEST_ASSERT_EQUAL_UINT32(6, b.peak);
    TEST_ASSERT_TRUE(b.light == dance::BudgetLight::Green);
    TEST_ASSERT_EQUAL_INT(6, b.cases);
  }
  OpenPack op;
  TEST_ASSERT_TRUE(op.open(beatscript::b4Pack()));
  dance::BudgetCaseSpec specs[dance::kBudgetMaxCases];
  // Unranged, travel 1, no mirror flag: paces 72, 124, 176 and the start spots -1 and 0.
  TEST_ASSERT_EQUAL_INT(12, dance::budgetCaseSpecs(op.pack, 0, specs));
  int i = 0;
  for (int fps : {24, 30})
    for (int pace : {72, 124, 176})
      for (int spot : {-1, 0}) {
        ctx("B.4's case %d", i);
        TEST_ASSERT_EQUAL_INT_MESSAGE(fps, specs[i].fps, g_ctx);
        TEST_ASSERT_EQUAL_INT_MESSAGE(pace, specs[i].pace, g_ctx);
        TEST_ASSERT_FALSE_MESSAGE(specs[i].mirrored, g_ctx);
        TEST_ASSERT_EQUAL_INT_MESSAGE(spot, specs[i].spot, g_ctx);
        ++i;
      }
  const dance::BudgetCaseResult c30 = dance::budgetCase(op.pack, 0, spec(30, 124, false, -1), scratch.get());
  TEST_ASSERT_EQUAL_INT(30, c30.frames);
  TEST_ASSERT_EQUAL_UINT32(160, c30.median);
  TEST_ASSERT_EQUAL_UINT32(266, c30.peak);
  // 24 fps, pace 124 (B.6 names no spot; the move fits both, so both agree).
  for (int spot : {-1, 0}) {
    const dance::BudgetCaseResult c24 = dance::budgetCase(op.pack, 0, spec(24, 124, false, spot), scratch.get());
    TEST_ASSERT_EQUAL_UINT32(176, c24.median);
    TEST_ASSERT_EQUAL_UINT32(304, c24.peak);
  }
  TEST_ASSERT_EQUAL_UINT32(192, dance::budgetCase(op.pack, 0, spec(24, 176, false, -1), scratch.get()).median);
  const dance::BudgetResult b = dance::budget(op.pack, 0, scratch.get());
  TEST_ASSERT_EQUAL_UINT32(192, b.median);
  TEST_ASSERT_EQUAL_UINT32(304, b.peak);
  TEST_ASSERT_TRUE(b.light == dance::BudgetLight::Green);
  TEST_ASSERT_EQUAL_INT(12, b.cases);
  // B.4's trace through BudgetRun: frame n is at n * 33 ms, pos16 =
  // (n * 33 * 124 * 65536) // 5000, and the first frame of the run is B.4's
  // tick 0 (root 62,153, rect 57,141-67,155) with dirty 0.
  dance::BudgetRun run(op.pack, 0, spec(30, 124, false, -1));
  dance::BudgetFrame f;
  int n = 0;
  uint32_t peak = 0;
  while (run.next(&f)) {
    ctx("B.4's trace, frame %d", n);
    TEST_ASSERT_EQUAL_INT_MESSAGE(n, f.n, g_ctx);
    TEST_ASSERT_EQUAL_UINT32_MESSAGE(static_cast<uint32_t>((int64_t(n) * 33 * 124 * 65536) / 5000), f.pos16, g_ctx);
    if (n == 0) {
      TEST_ASSERT_EQUAL_INT_MESSAGE(62, f.place.rootX, g_ctx);
      TEST_ASSERT_TRUE_MESSAGE(sameRect(rect(57, 141, 67, 155), f.place.rect), g_ctx);
      TEST_ASSERT_EQUAL_UINT32_MESSAGE(0, f.dirty, g_ctx);
    }
    peak = std::max(peak, f.dirty);
    ++n;
  }
  TEST_ASSERT_EQUAL_INT(31, n);  // N = 30: frames 0..30
  TEST_ASSERT_EQUAL_UINT32(266, peak);
}

// ===========================================================================
// 6. The peak is never under a frame's own rect.

void test_peak_covers_every_rect() {
  OpenPack fixture, dot, b4;
  TEST_ASSERT_TRUE(fixture.open(packedit::testPack()));
  TEST_ASSERT_TRUE(dot.open(packedit::dotPack()));
  TEST_ASSERT_TRUE(b4.open(beatscript::b4Pack()));
  Scratch scratch;
  int cases = 0;
  for (const dance::Pack* p : {&fixture.pack, &dot.pack, &b4.pack}) {
    for (int m = 0; m < p->moveCount(); ++m) {
      dance::BudgetCaseSpec specs[dance::kBudgetMaxCases];
      const int n = dance::budgetCaseSpecs(*p, m, specs);
      for (int i = 0; i < n; ++i) {
        ctx("%s move %d case %d", p->id(), m, i);
        dance::BudgetRun run(*p, m, specs[i]);
        dance::BudgetFrame f;
        std::vector<uint32_t> values;
        uint32_t biggestRect = 0;
        dance::StageRect last;
        bool haveLast = false;
        while (run.next(&f)) {
          // The dirty value is B.5's rule on the last frame's rect and this one's.
          TEST_ASSERT_EQUAL_UINT32_MESSAGE(haveLast ? dance::dirtyPx(&last, f.place.rect) : 0, f.dirty, g_ctx);
          if (f.n >= 1) {
            values.push_back(f.dirty);
            biggestRect = std::max(biggestRect, static_cast<uint32_t>(dance::rectArea(f.place.rect)));
          }
          last = f.place.rect;
          haveLast = true;
        }
        const dance::BudgetCaseResult r = dance::budgetCase(*p, m, specs[i], scratch.get());
        TEST_ASSERT_EQUAL_INT_MESSAGE(static_cast<int>(values.size()), r.frames, g_ctx);
        TEST_ASSERT_TRUE_MESSAGE(r.peak >= biggestRect, g_ctx);
        // The lower median and the peak of those values (B.6).
        std::vector<uint32_t> sorted = values;
        std::sort(sorted.begin(), sorted.end());
        if (!sorted.empty()) {
          TEST_ASSERT_EQUAL_UINT32_MESSAGE(sorted[(sorted.size() - 1) / 2], r.median, g_ctx);
          TEST_ASSERT_EQUAL_UINT32_MESSAGE(sorted.back(), r.peak, g_ctx);
        }
        ++cases;
      }
    }
  }
  TEST_ASSERT_TRUE(cases >= 92 + 6 + 12);
}

// ===========================================================================
// 7. The verdicts: D.2's start-spot hook and budgetRed.

void test_verdicts() {
  {
    OpenPack op;
    TEST_ASSERT_TRUE(op.open(packedit::testPack()));
    for (int m = 0; m < op.pack.moveCount(); ++m) {
      ctx("fixture move %d (%s)", m, op.pack.moveName(m));
      dance::Reason why;
      TEST_ASSERT_TRUE_MESSAGE(dance::startSpots(nullptr, op.pack, m, &why), g_ctx);
      dance::Reason red;
      TEST_ASSERT_FALSE_MESSAGE(dance::budgetRed(op.pack, m, &red), g_ctx);  // heavy is heavy, big amber
    }
    // The fixture through the hook: only `future` is dropped, as without it.
    OpenPack hooked;
    dance::OpenOptions o;
    o.late = &dance::startSpots;
    TEST_ASSERT_TRUE(hooked.open(packedit::testPack(), &o));
    TEST_ASSERT_EQUAL_STRING("8:song_bpm needs track BPM data: skipped in this version", hooked.drops.str().c_str());
  }
  {
    // heavy without kHeavy: red, as `budget red (24576 px)`.
    OpenPack op;
    TEST_ASSERT_TRUE(op.open(patchedFixture(&clearHeavy)));
    dance::Reason why;
    TEST_ASSERT_TRUE(dance::budgetRed(op.pack, beatscript::kHeavy, &why));
    TEST_ASSERT_TRUE(why.why == dance::Why::BudgetRed);
    TEST_ASSERT_EQUAL_UINT32(24576, why.a);
    TEST_ASSERT_EQUAL_STRING("budget red (24576 px)", reasonText(why).c_str());
    for (int m = 0; m < op.pack.moveCount(); ++m) {
      if (m == beatscript::kHeavy) continue;
      dance::Reason r;
      TEST_ASSERT_FALSE(dance::budgetRed(op.pack, m, &r));
    }
    // budgetRed reads the record's flags, not the light alone: big stays amber.
    dance::Reason r;
    TEST_ASSERT_FALSE(dance::budgetRed(op.pack, beatscript::kBig, &r));
  }
  {
    // walk with no start spot in any orientation it plays in.
    const Bytes t = patchedFixture(&walkFromNoSpot);
    OpenPack op;
    TEST_ASSERT_TRUE(op.open(t));
    int lo = 0, hi = 0;
    TEST_ASSERT_TRUE(dance::extent(op.pack, beatscript::kWalk, false, &lo, &hi));
    TEST_ASSERT_EQUAL_INT(-24, lo);
    TEST_ASSERT_EQUAL_INT(68, hi);
    TEST_ASSERT_TRUE(dance::extent(op.pack, beatscript::kWalk, true, &lo, &hi));
    TEST_ASSERT_EQUAL_INT(-64, lo);
    TEST_ASSERT_EQUAL_INT(28, hi);
    TEST_ASSERT_EQUAL_HEX8(0x00, dance::startSpotMask(op.pack, beatscript::kWalk, false));
    TEST_ASSERT_EQUAL_HEX8(0x02, dance::startSpotMask(op.pack, beatscript::kWalk, true));
    dance::Reason why;
    TEST_ASSERT_FALSE(dance::startSpots(nullptr, op.pack, beatscript::kWalk, &why));
    TEST_ASSERT_TRUE(why.why == dance::Why::TravelsFromNoSpot);
    TEST_ASSERT_EQUAL_STRING("travels from no spot", reasonText(why).c_str());
    // Through the hook, inside open(): dropped in MOVS order, before `future`.
    OpenPack hooked;
    dance::OpenOptions o;
    o.late = &dance::startSpots;
    TEST_ASSERT_TRUE(hooked.open(t, &o));
    TEST_ASSERT_EQUAL_STRING("6:travels from no spot|8:song_bpm needs track BPM data: skipped in this version",
                             hooked.drops.str().c_str());
    TEST_ASSERT_EQUAL_INT(12, hooked.pack.keptMoves());
    // With its mirror flag back, the mirrored spot 0 counts: kept.
    Bytes back = t;
    back[recordAt(back, beatscript::kWalk) + 8] |= dance::kMirror;
    packedit::fixCrc(back);
    OpenPack kept;
    TEST_ASSERT_TRUE(kept.open(back, &o));
    TEST_ASSERT_EQUAL_STRING("8:song_bpm needs track BPM data: skipped in this version", kept.drops.str().c_str());
  }
  {
    // B.4's move: travel 1 from -1 and 0, kept; a move without travel is
    // never dropped by the hook.
    OpenPack op;
    dance::OpenOptions o;
    o.late = &dance::startSpots;
    TEST_ASSERT_TRUE(op.open(beatscript::b4Pack(), &o));
    TEST_ASSERT_EQUAL_INT(0, op.report.dropped);
    TEST_ASSERT_EQUAL_INT(3, op.pack.keptMoves());
  }
}

// ===========================================================================
// 8. BudgetPass: one kept move a call, red ones dropped through dropMove.

void test_budget_pass() {
  {
    // The fixture as a card pack: no drop, 13 true steps.
    CardDancer d;
    TEST_ASSERT_TRUE(d.load(packedit::testPack()));
    TEST_ASSERT_EQUAL_INT(13, d.passSteps);
    TEST_ASSERT_EQUAL_STRING("8:song_bpm needs track BPM data: skipped in this version", d.drops.str().c_str());
    TEST_ASSERT_EQUAL_UINT8(1, d.report.dropped);
    TEST_ASSERT_EQUAL_INT(13, d.pack.keptMoves());
  }
  {
    // Two red moves: their drops arrive after open()'s, in MOVS order, one
    // per step(), with dropped and keptMoves following.
    const Bytes t = patchedFixture(&twoRed);
    OpenPack op;
    dance::OpenOptions o;
    o.late = &dance::startSpots;
    TEST_ASSERT_TRUE(op.open(t, &o));
    TEST_ASSERT_EQUAL_STRING("8:song_bpm needs track BPM data: skipped in this version", op.drops.str().c_str());
    Scratch scratch;
    TEST_ASSERT_EQUAL_UINT32(24576, dance::budget(op.pack, beatscript::kBig, scratch.get()).peak);
    op.drops.lastMove = -1;
    dance::BudgetPass pass;
    pass.begin(&op.pack, &op.report);
    TEST_ASSERT_FALSE(pass.done());
    const int checked[13] = {0, 1, 2, 3, 4, 5, 6, 7, 9, 10, 11, 12, 13};
    for (int s = 0; s < 13; ++s) {
      ctx("step %d checks move %d", s + 1, checked[s]);
      TEST_ASSERT_TRUE_MESSAGE(pass.step(), g_ctx);
      const int m = checked[s];
      const int dropped = 1 + (m >= 9) + (m >= 10);
      TEST_ASSERT_EQUAL_INT_MESSAGE(dropped, op.report.dropped, g_ctx);
      TEST_ASSERT_EQUAL_INT_MESSAGE(14 - dropped, op.pack.keptMoves(), g_ctx);
      TEST_ASSERT_EQUAL_INT_MESSAGE(dropped, op.drops.calls, g_ctx);
    }
    TEST_ASSERT_FALSE(pass.step());
    TEST_ASSERT_TRUE(pass.done());
    TEST_ASSERT_FALSE(pass.step());  // stays done
    TEST_ASSERT_EQUAL_STRING(
        "8:song_bpm needs track BPM data: skipped in this version|9:budget red (24576 px)|10:budget red (24576 px)",
        op.drops.str().c_str());
    TEST_ASSERT_FALSE(op.drops.outOfOrder);
    TEST_ASSERT_FALSE(op.pack.moveKept(9));
    TEST_ASSERT_FALSE(op.pack.moveKept(10));
    TEST_ASSERT_TRUE(op.pack.moveKept(11));
    // Without a report: the drops still happen.
    OpenPack quiet;
    TEST_ASSERT_TRUE(quiet.open(t, &o));
    dance::BudgetPass p2;
    p2.begin(&quiet.pack);
    int steps = 0;
    while (p2.step()) ++steps;
    TEST_ASSERT_EQUAL_INT(13, steps);
    TEST_ASSERT_EQUAL_INT(11, quiet.pack.keptMoves());
  }
  {
    // A pack with no kept move: false at once.
    const Bytes noMoves = packedit::dotWith({{"MOVS", packedit::hex("00 20 00 00")}, {"STEP", Bytes()}});
    OpenPack op;
    TEST_ASSERT_TRUE(op.open(noMoves));
    TEST_ASSERT_EQUAL_INT(0, op.pack.moveCount());
    dance::BudgetPass pass;
    pass.begin(&op.pack, &op.report);
    TEST_ASSERT_FALSE(pass.step());
    TEST_ASSERT_TRUE(pass.done());
    // Every move dropped already (the dot's only move, by hand): the same.
    OpenPack dot;
    TEST_ASSERT_TRUE(dot.open(packedit::dotPack()));
    TEST_ASSERT_TRUE(dot.pack.dropMove(0, dance::Reason()));
    dance::BudgetPass p2;
    p2.begin(&dot.pack, &dot.report);
    TEST_ASSERT_FALSE(p2.step());
    TEST_ASSERT_TRUE(p2.done());
  }
  {
    // Not open, scanned only, and a null pack: done at once.
    dance::Pack none;
    dance::BudgetPass pass;
    pass.begin(&none);
    TEST_ASSERT_FALSE(pass.step());
    TEST_ASSERT_TRUE(pass.done());
    OpenPack sp;
    const Bytes t = packedit::testPack();
    sp.bytes.assign(t.data(), 2048);
    TEST_ASSERT_TRUE(sp.pack.scan(sp.bytes.data(), 2048, static_cast<uint32_t>(t.size())));
    dance::BudgetPass p2;
    p2.begin(&sp.pack);
    TEST_ASSERT_FALSE(p2.step());
    TEST_ASSERT_TRUE(p2.done());
    dance::BudgetPass p3;
    p3.begin(nullptr);
    TEST_ASSERT_FALSE(p3.step());
    TEST_ASSERT_TRUE(p3.done());
  }
  {
    // A heavy move is never dropped (no simulation), red or not.
    CardDancer d;
    TEST_ASSERT_TRUE(d.load(packedit::testPack()));
    TEST_ASSERT_TRUE(d.pack.moveKept(beatscript::kHeavy));
  }
}

// ===========================================================================
// 9. Added in review: case lists and lengths the fixture's data didn't
//    reach, and the pass in slices of frames (5.7).

namespace {
// Three 1- and 2-beat moves: `odd` 90-131 (rlo + rhi odd: the middle pace
// floors to 110), `one` 100-100 (one pace: the repeats dropped), and
// `trav`, B.4's move with kMirror (start spots -1, 0 and 0, +1: 24 cases,
// the most a move can have).
Bytes caseListPack() {
  using beatscript::MiniMove;
  MiniMove odd;
  odd.name = "odd";
  odd.beats = 1;
  odd.paceLo = 90;
  odd.paceHi = 131;
  odd.steps = {{0, false, 12, 0, 0, 0, false}};
  MiniMove one;
  one.name = "one";
  one.beats = 1;
  one.paceLo = 100;
  one.paceHi = 100;
  one.steps = {{0, false, 12, 2, 0, 1, false}};
  MiniMove trav;
  trav.name = "trav";
  trav.beats = 2;
  trav.travel = 1;
  trav.flags = dance::kMirror;
  trav.steps = {{0, false, 12, 0, 0, 3, false}, {0, false, 12, 3, -2, 2, true}};
  return beatscript::miniPack({2, 8, 8, 4, 8, 10}, {{2, 2, 4, 6}}, {odd, one, trav});
}

// A 12,000 ms idle (1,200 units), moving for its first 400 units and still
// for the last 800: N = 364 at 30 fps, the scratch's whole length.
Bytes longIdlePack() {
  beatscript::MiniMove idle;
  idle.name = "long";
  idle.kind = 1;
  idle.beats = 0;
  idle.when = 3;
  idle.steps = {{0, false, 200, -40, 0, 1, false},
                {0, false, 200, 40, 0, 1, false},
                {0, false, 400, 0, 0, 0, false},
                {0, false, 400, 0, 0, 0, false}};
  return beatscript::miniPack({1, 16, 16, 8, 16, 20}, {{2, 2, 12, 14}}, {idle});
}

// Frames one whole kept, unheavy move takes in BudgetPass: every case's
// frames 0..N.
long passFrames(const dance::Pack& p, int m) {
  dance::BudgetCaseSpec specs[dance::kBudgetMaxCases];
  const int n = dance::budgetCaseSpecs(p, m, specs);
  long frames = 0;
  for (int i = 0; i < n; ++i) {
    dance::BudgetRun run(p, m, specs[i]);
    while (run.next(nullptr)) ++frames;
  }
  return frames;
}
}  // namespace

// The case lists, every case's N, median and peak, and the moves' budgets
// are dancepack.py's for the same bytes (_case_specs and budget()).
void test_case_lists_beyond_the_fixture() {
  OpenPack op;
  TEST_ASSERT_TRUE(op.open(caseListPack()));
  TEST_ASSERT_EQUAL_INT(3, op.pack.keptMoves());
  struct Case {
    int fps, pace, mirrored, spot, frames, median, peak;
  };
  const std::vector<Case> odd = {{24, 90, 0, 0, 16, 140, 140},  {24, 110, 0, 0, 13, 140, 140},
                                 {24, 131, 0, 0, 11, 140, 140}, {30, 90, 0, 0, 21, 140, 140},
                                 {30, 110, 0, 0, 17, 140, 140}, {30, 131, 0, 0, 14, 140, 140}};
  const std::vector<Case> one = {{24, 100, 0, 0, 15, 140, 140}, {30, 100, 0, 0, 19, 140, 140}};
  const std::vector<Case> trav = {
      {24, 72, 0, -1, 40, 144, 280},  {24, 72, 0, 0, 40, 144, 280},   {24, 72, 1, 0, 40, 144, 308},
      {24, 72, 1, 1, 40, 144, 308},   {24, 124, 0, -1, 24, 144, 260}, {24, 124, 0, 0, 24, 144, 260},
      {24, 124, 1, 0, 24, 153, 304},  {24, 124, 1, 1, 24, 153, 304},  {24, 176, 0, -1, 17, 150, 260},
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      {30, 176, 0, 0, 21, 144, 280},  {30, 176, 1, 0, 21, 153, 308},  {30, 176, 1, 1, 21, 153, 308}};
  const struct {
    const std::vector<Case>* cases;
    uint32_t median, peak;
  } moves[3] = {{&odd, 140, 140}, {&one, 140, 140}, {&trav, 153, 308}};
  Scratch scratch;
  for (int m = 0; m < 3; ++m) {
    const std::vector<Case>& want = *moves[m].cases;
    dance::BudgetCaseSpec specs[dance::kBudgetMaxCases];
    const int n = dance::budgetCaseSpecs(op.pack, m, specs);
    ctx("move %d", m);
    TEST_ASSERT_EQUAL_INT_MESSAGE(static_cast<int>(want.size()), n, g_ctx);
    for (int i = 0; i < n; ++i) {
      const Case& w = want[static_cast<size_t>(i)];
      ctx("move %d case %d", m, i);
      TEST_ASSERT_EQUAL_INT_MESSAGE(w.fps, specs[i].fps, g_ctx);
      TEST_ASSERT_EQUAL_INT_MESSAGE(w.pace, specs[i].pace, g_ctx);
      TEST_ASSERT_EQUAL_INT_MESSAGE(w.mirrored, specs[i].mirrored ? 1 : 0, g_ctx);
      TEST_ASSERT_EQUAL_INT_MESSAGE(w.spot, specs[i].spot, g_ctx);
      const dance::BudgetCaseResult r = dance::budgetCase(op.pack, m, specs[i], scratch.get());
      TEST_ASSERT_EQUAL_INT_MESSAGE(w.frames, r.frames, g_ctx);
      TEST_ASSERT_EQUAL_UINT32_MESSAGE(w.median, r.median, g_ctx);
      TEST_ASSERT_EQUAL_UINT32_MESSAGE(w.peak, r.peak, g_ctx);
    }
    const dance::BudgetResult b = dance::budget(op.pack, m, scratch.get());
    TEST_ASSERT_EQUAL_INT_MESSAGE(n, b.cases, g_ctx);
    TEST_ASSERT_EQUAL_UINT32_MESSAGE(moves[m].median, b.median, g_ctx);
    TEST_ASSERT_EQUAL_UINT32_MESSAGE(moves[m].peak, b.peak, g_ctx);
  }
  TEST_ASSERT_EQUAL_INT(dance::kBudgetMaxCases, static_cast<int>(trav.size()));
}

// The longest case a kept move has: a 12 s idle at 30 fps is N = 364, the
// scratch's length, every value of it in the median (dancepack.py: 286 and
// 364 frames, median 320, peak 640; the early, moving frames are the busy
// ones, so a scratch that kept fewer would raise the median).
void test_longest_case() {
  OpenPack op;
  TEST_ASSERT_TRUE(op.open(longIdlePack()));
  Scratch scratch;
  const struct {
    int fps, frames;
  } want[2] = {{24, 286}, {30, 364}};
  for (const auto& w : want) {
    ctx("the 12 s idle at %d fps", w.fps);
    const dance::BudgetCaseResult r = dance::budgetCase(op.pack, 0, spec(w.fps, 0, false, 0), scratch.get());
    TEST_ASSERT_EQUAL_INT_MESSAGE(w.frames, r.frames, g_ctx);
    TEST_ASSERT_EQUAL_UINT32_MESSAGE(320, r.median, g_ctx);
    TEST_ASSERT_EQUAL_UINT32_MESSAGE(640, r.peak, g_ctx);
    dance::BudgetRun run(op.pack, 0, spec(w.fps, 0, false, 0));
    dance::BudgetFrame f;
    std::vector<uint32_t> values;
    while (run.next(&f))
      if (f.n >= 1) values.push_back(f.dirty);
    TEST_ASSERT_EQUAL_INT_MESSAGE(w.frames, static_cast<int>(values.size()), g_ctx);
    std::vector<uint32_t> firstHalf(values.begin(), values.begin() + static_cast<long>(values.size() / 2));
    std::sort(firstHalf.begin(), firstHalf.end());
    TEST_ASSERT_TRUE_MESSAGE(firstHalf[(firstHalf.size() - 1) / 2] > 320, g_ctx);  // the busy half's median
    std::sort(values.begin(), values.end());
    TEST_ASSERT_EQUAL_UINT32_MESSAGE(values[(values.size() - 1) / 2], r.median, g_ctx);
  }
  TEST_ASSERT_EQUAL_INT(364, dance::kBudgetMaxFrames);
}

// BudgetPass::run in slices: at most maxFrames frames a call (0 counts as
// 1), each move's verdict on the call that ends its last case, and the same
// drops in the same order as step() and budgetRed, whatever the slice.
void test_budget_pass_slices() {
  const Bytes t = patchedFixture(&twoRed);
  dance::OpenOptions o;
  o.late = &dance::startSpots;
  {
    OpenPack op;
    TEST_ASSERT_TRUE(op.open(t, &o));
    // run(1): one frame a call, so a move costs its frames plus the call
    // that gives its verdict; a heavy move (none here) one call.
    long want = 0;
    for (int m = 0; m < op.pack.moveCount(); ++m) {
      if (!op.pack.moveKept(m)) continue;
      want += (op.pack.moveRecord(m).flags & dance::kHeavy) ? 1 : passFrames(op.pack, m) + 1;
    }
    op.drops.lastMove = -1;
    dance::BudgetPass pass;
    pass.begin(&op.pack, &op.report);
    long calls = 0;
    long droppedAt9 = -1;
    for (;;) {
      const bool more = (calls % 2) ? pass.run(1) : pass.run(0);
      if (!more) break;
      ++calls;
      if (droppedAt9 < 0 && !op.pack.moveKept(9)) droppedAt9 = calls;
    }
    TEST_ASSERT_EQUAL_INT(static_cast<int>(want), static_cast<int>(calls));
    TEST_ASSERT_TRUE(pass.done());
    TEST_ASSERT_FALSE(pass.run(100));
    TEST_ASSERT_EQUAL_STRING(
        "8:song_bpm needs track BPM data: skipped in this version|9:budget red (24576 px)|10:budget red (24576 px)",
        op.drops.str().c_str());
    // Move 9 was dropped on the call after its last frame: every move before
    // it, and 9's own frames, came first.
    long before = 0;
    OpenPack fresh;
    TEST_ASSERT_TRUE(fresh.open(t, &o));
    for (int m = 0; m <= 9; ++m)
      if (fresh.pack.moveKept(m)) before += passFrames(fresh.pack, m) + 1;
    TEST_ASSERT_EQUAL_INT(static_cast<int>(before), static_cast<int>(droppedAt9));
  }
  for (uint32_t slice : {2u, 7u, 64u, dance::kBudgetSliceFrames, 100000u}) {
    ctx("slices of %u frames", static_cast<unsigned>(slice));
    OpenPack a, b;
    TEST_ASSERT_TRUE_MESSAGE(a.open(t, &o), g_ctx);
    TEST_ASSERT_TRUE_MESSAGE(b.open(t, &o), g_ctx);
    a.drops.lastMove = b.drops.lastMove = -1;
    dance::BudgetPass pa, pb;
    pa.begin(&a.pack, &a.report);
    pb.begin(&b.pack, &b.report);
    int steps = 0;
    while (pa.step()) ++steps;
    TEST_ASSERT_EQUAL_INT_MESSAGE(13, steps, g_ctx);
    while (pb.run(slice)) {
    }
    TEST_ASSERT_EQUAL_STRING_MESSAGE(a.drops.str().c_str(), b.drops.str().c_str(), g_ctx);
    TEST_ASSERT_EQUAL_INT_MESSAGE(a.pack.keptMoves(), b.pack.keptMoves(), g_ctx);
    TEST_ASSERT_TRUE_MESSAGE(pb.done(), g_ctx);
  }
  {
    // A pack cleared mid-pass: false, and done.
    OpenPack op;
    TEST_ASSERT_TRUE(op.open(t, &o));
    dance::BudgetPass pass;
    pass.begin(&op.pack);
    TEST_ASSERT_TRUE(pass.run(5));
    TEST_ASSERT_FALSE(pass.done());
    op.pack.clear();
    TEST_ASSERT_FALSE(pass.run(5));
    TEST_ASSERT_TRUE(pass.done());
  }
}

int main(int, char**) {
  UNITY_BEGIN();
  RUN_TEST(test_dirty_rule);
  RUN_TEST(test_budget_cases);
  RUN_TEST(test_move_budgets);
  RUN_TEST(test_traces);
  RUN_TEST(test_worked_examples);
  RUN_TEST(test_peak_covers_every_rect);
  RUN_TEST(test_verdicts);
  RUN_TEST(test_budget_pass);
  RUN_TEST(test_case_lists_beyond_the_fixture);
  RUN_TEST(test_longest_case);
  RUN_TEST(test_budget_pass_slices);
  return UNITY_END();
}
